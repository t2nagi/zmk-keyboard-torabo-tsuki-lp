## boards/shields/torabo_tsuki_lp/Kconfig.defconfig
```kconfig
if SHIELD_TORABO_TSUKI_LP_LEFT || SHIELD_TORABO_TSUKI_LP_RIGHT

config ZMK_KEYBOARD_NAME
    default "torabo-tsuki-s" if TORABO_KB_NAME_S
    default "torabo-tsuki-xs" if TORABO_KB_NAME_XS
    default "torabo-nashi" if TORABO_KB_NAME_NASHI
    default "torabo-tsuki"

config ZMK_SPLIT
    default y

config SPI
    default y

config INPUT
    default y

config ZMK_MOUSE
    default y
 
endif
```

## boards/shields/torabo_tsuki_lp/Kconfig.shield
```kconfig
config SHIELD_TORABO_TSUKI_LP_LEFT
    def_bool $(shields_list_contains,torabo_tsuki_lp_left)

config SHIELD_TORABO_TSUKI_LP_RIGHT
    def_bool $(shields_list_contains,torabo_tsuki_lp_right)

# ビルドごとのBLE端末名を選ぶスイッチ（build.yaml の cmake-args から -DCONFIG_..=y で指定）
config TORABO_KB_NAME_S
    bool "Keyboard name: torabo-tsuki-s"

config TORABO_KB_NAME_XS
    bool "Keyboard name: torabo-tsuki-xs"

config TORABO_KB_NAME_NASHI
    bool "Keyboard name: torabo-nashi"
```

## config/west.yml
```yaml
manifest:
  remotes:
    - name: zmkfirmware
      url-base: https://github.com/zmkfirmware
    - name: sekigon-gonnoc
      url-base: https://github.com/sekigon-gonnoc
    - name: amgskobo
      url-base: https://github.com/amgskobo
  projects:
    - name: zmk
      remote: zmkfirmware
      revision: v0.3
      import: app/west.yml
    - name: zmk-component-bmp-boost
      remote: sekigon-gonnoc
      import: west.yml
      revision: v0.2
    - name: zmk-feature-status-led
      remote: sekigon-gonnoc
      revision: main
    - name: zmk-driver-paw3222
      remote: sekigon-gonnoc
      revision: torabo-tsuki
    - name: zmk-driver-iqs7211e
      remote: sekigon-gonnoc
    - name: zmk-feature-cdc-acm-bootloader-trigger
      remote: sekigon-gonnoc
      revision: v0.2
    - name: zmk-feature-non-lipo-battery-management
      remote: sekigon-gonnoc
      revision: main
    - name: zmk-input-inertia
      remote: amgskobo
      # ZMK v0.3 (Zephyr 3.5系) は zmk_endpoints_send_mouse_report (複数形) のみ提供。
      # このモジュールは 2026-02-15 以降 zmk_endpoint_send_mouse_report (単数形) を呼ぶため
      # src/zmk_endpoint_compat.c で互換シムを用意している。SHAは動作確認済みのものに固定。
      revision: 7d4831d0422637432ad55926690b1e7000eb249d
  self:
    path: config
```
