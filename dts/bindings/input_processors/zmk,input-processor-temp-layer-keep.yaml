## dts/bindings/input_processors/zmk,input-processor-temp-layer-keep.yaml
```yaml
# SPDX-License-Identifier: MIT

description: |
  Temp layer input processor (based on zmk,input-processor-temp-layer).
  Unlike the upstream one, pressing an excluded position (e.g. mouse buttons)
  keeps the layer active while held and restarts the timeout on release.

compatible: "zmk,input-processor-temp-layer-keep"

include: ip_two_param.yaml

properties:
  require-prior-idle-ms:
    type: int
    default: 0
    description: Time in milliseconds that must pass after the last keystroke before the layer can be activated

  excluded-positions:
    type: array
    required: true
    description: Key positions that keep the layer active (and reset the timeout) instead of deactivating it
```
